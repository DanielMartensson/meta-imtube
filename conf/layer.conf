## conf/layer.conf
```bitbake
# meta-imtube – lightweight Qt6/QML YouTube client with HW-accelerated
# GStreamer rendering.
BBPATH .= ":${LAYERDIR}"

BBFILES += " \
    ${LAYERDIR}/recipes-*/*/*.bb \
    ${LAYERDIR}/recipes-*/*/*/*.bb \
    ${LAYERDIR}/recipes-*/*/*.bbappend \
    ${LAYERDIR}/recipes-*/*/*/*.bbappend \
"

BBFILE_COLLECTIONS += "imtube"
BBFILE_PATTERN_imtube = "^${LAYERDIR}/"
BBFILE_PRIORITY_imtube = "8"

LAYERDEPENDS_imtube = "qt6-layer"
LAYERSERIES_COMPAT_imtube = "scarthgap"
```
